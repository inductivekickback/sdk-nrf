## drivers/rad_rx/Kconfig
```kconfig
# Rad receiver driver
#
# Copyright (c) 2021 Daniel Veilleux
#
# SPDX-License-Identifier: LicenseRef-BSD-5-Clause-Nordic
#

menuconfig RAD_RX
	bool "Rad laser tag receiver driver"
	select GPIO
	help
	  Enable Rad laser tag receiver driver

if RAD_RX

config RAD_RX_ACCEPT_DYNASTY
	bool "Accept messages from Dynasty Toys blasters (probably also Kidzlane, JOYMOR, etc.)"
	select RAD_MESSAGE_TYPE_RAD
	default y
	help
		Accept messages from Dynasty Toys blasters, a generic and now defunct brand

config RAD_RX_ACCEPT_LASER_X
	bool "Accept messages from Laser X blasters"
	default y
	help
		Accept messages from Laser X blasters

config RAD_RX_ACCEPT_RAD
	bool "Accept messages from Rad blasters"
	default y
	help
		Accept messages from Rad blasters

config RAD_RX_INIT_PRIORITY
	int "Rad laser tag receiver init priority"
	default 90
	help
	  Rad laser tag receiver init priority

module = RAD_RX
module-str = RAD_RX
source "${ZEPHYR_BASE}/subsys/logging/Kconfig.template.log_config"

endif #RAD_RX
```

## drivers/rad_tx/Kconfig
```kconfig
# Rad transmitter driver
#
# Copyright (c) 2021 Daniel Veilleux
#
# SPDX-License-Identifier: LicenseRef-BSD-5-Clause-Nordic
#

menuconfig RAD_TX
	bool "Rad laser tag transmitter driver"
	select GPIO
	help
	  Enable Rad laster tag transmitter driver

if RAD_TX

config RAD_TX_DYNASTY
	bool "Enable sending messages to Dynasty Toys blasters (probably also Kidzlane, JOYMOR, etc.)"
	select RAD_MSG_TYPE_DYNASTY
	default y
	help
		Enable sending messages to Dynasty Toys blasters, a generic and now defunct brand

config RAD_TX_LASER_X
	bool "Enable sending messages to Laser X blasters"
	select RAD_MSG_TYPE_LASER_X
	default y
	help
		Enable sending messages to Laser X blasters

config RAD_TX_RAD
	bool "Enable sending messages to Rad blasters"
	select RAD_MSG_TYPE_RAD
	default y
	help
		Enable sending messages to Rad blasters

config RAD_TX_INIT_PRIORITY
	int "Rad laser tag transmitter init priority"
	default 90
	help
	  Rad laser tag transmitter init priority

module = RAD_TX
module-str = RAD_TX
source "${ZEPHYR_BASE}/subsys/logging/Kconfig.template.log_config"

endif #RAD_TX
```

## drivers/servo/Kconfig
```kconfig
# Nordic servo
#
# Copyright (c) 2021 Daniel Veilleux
#
# SPDX-License-Identifier: LicenseRef-BSD-5-Clause-Nordic
#

menuconfig NORDIC_SERVO
	bool "Nordic servo"
	select NRFX_PWM
	help
	  Enable Nordic servo driver

if NORDIC_SERVO

config NORDIC_SERVO_ALLOW_PWM0
	bool "Allow PWM0"
	default true
    select NRFX_PWM0
	help
		Allow the driver to use PWM peripheral instance 0

config NORDIC_SERVO_ALLOW_PWM1
	bool "Allow PWM1"
	default true
    select NRFX_PWM1
	help
		Allow the driver to use PWM peripheral instance 1

config NORDIC_SERVO_ALLOW_PWM2
	bool "Allow PWM2"
	default true
    select NRFX_PWM2
	help
		Allow the driver to use PWM peripheral instance 2

config NORDIC_SERVO_ALLOW_PWM3
	bool "Allow PWM3"
	default true
    select NRFX_PWM3
	help
		Allow the driver to use PWM peripheral instance 3

config NORDIC_SERVO_INIT_PRIORITY
	int "Servo init priority"
	default 90
	help
	  Servo initialization priority

module = NORDIC_SERVO
module-str = NORDIC-SERVO
source "${ZEPHYR_BASE}/subsys/logging/Kconfig.template.log_config"

endif #NORDIC_SERVO
```

## dts/bindings/servo/nordic_sensor.yaml
```yaml
# Copyright (c) 2021 Daniel Veilleux
# SPDX-License-Identifier: LicenseRef-BSD-5-Clause-Nordic

description: Nordic servo

compatible: "nordic,servo"

include: base.yaml

properties:
  label:
    required: true
    type: string
    description: Human readable string describing the device (used as device_get_binding() argument)

  status:
    required: true
    type: string
    description: Human readable string describing the device's status

  pin:
    type: int
    description: Output pin, using NRFX-compatible index
    required: true

  init_value:
    type: int
    description: Initial value [0, 100]
    required: true
```
