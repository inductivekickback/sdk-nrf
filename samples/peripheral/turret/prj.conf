## CMakeLists.txt
```
#
# Copyright (c) 2020 Nordic Semiconductor
#
# SPDX-License-Identifier: LicenseRef-BSD-5-Clause-Nordic
#

cmake_minimum_required(VERSION 3.13.1)

find_package(Zephyr REQUIRED HINTS $ENV{ZEPHYR_BASE})
project(turret)

FILE(GLOB app_sources src/*.c)
target_sources(app PRIVATE
	${app_sources}
)
target_include_directories(app PRIVATE include)
```

## prj.conf
```kconfig
#
# Copyright (c) 2020 Nordic Semiconductor
#
# SPDX-License-Identifier: LicenseRef-BSD-5-Clause-Nordic
#
CONFIG_HEAP_MEM_POOL_SIZE=2048
CONFIG_SYSTEM_WORKQUEUE_STACK_SIZE=2048
CONFIG_MAIN_STACK_SIZE=1024

CONFIG_LOG=y
CONFIG_USE_SEGGER_RTT=n
CONFIG_LOG_BACKEND_RTT=n
CONFIG_LOG_BACKEND_UART=y
CONFIG_CONSOLE=y
CONFIG_UART_CONSOLE=y
CONFIG_SERIAL=y

CONFIG_NRFX_PWM0=y

CONFIG_GPIO=y
CONFIG_DK_LIBRARY=y

CONFIG_NO_OPTIMIZATIONS=y
CONFIG_ASSERT=y
CONFIG_DEBUG=y
```

## boards/nrf52840dk_nrf52840.overlay
```dts
/* SPDX-License-Identifier: LicenseRef-BSD-5-Clause-Nordic */
```

## src/main.c
```c
/*
 * Copyright (c) 2020 Nordic Semiconductor ASA
 *
 * SPDX-License-Identifier: LicenseRef-BSD-5-Clause-Nordic
 */

#include <zephyr.h>
#include <logging/log.h>

#include <nrfx_pwm.h>
#include <dk_buttons_and_leds.h>

#include "dynasty_toys.h"
#include "laser_x.h"

#define LOG_MODULE_NAME app
LOG_MODULE_REGISTER(LOG_MODULE_NAME);

#define PWM_PIN 31

/*
 * With an 8MHz clock the 37.9KHz period is ~211 ticks.
 */
#define TICKS_PER_PERIOD 		211
#define DUTY_CYCLE_0     		TICKS_PER_PERIOD
#define DUTY_CYCLE_50    		(TICKS_PER_PERIOD / 2)
#define REFRESH_COUNT_400US    	14

static nrfx_pwm_t m_pwm = NRFX_PWM_INSTANCE(0);

static void m_button_changed(uint32_t button_state, uint32_t has_changed)
{
	uint32_t buttons = button_state & has_changed;
	LOG_INF("button_changed: %x", buttons);
}

static void m_configure_gpio(void)
{
	int err;
	err = dk_buttons_init(m_button_changed);
	if (err) {
		LOG_ERR("Cannot init buttons (err: %d)", err);
	}

	err = dk_leds_init();
	if (err) {
		LOG_ERR("Cannot init LEDs (err: %d)", err);
	}
}

static void m_pwm_handler(nrfx_pwm_evt_type_t event_type, void * p_context)
{
	// TODO: Wait for the NRFX_PWM_EVT_STOPPED event before allowing next blast.
	LOG_INF("PWM event: %d", event_type);
}

static nrfx_err_t m_pwm_config(void)
{
	nrfx_pwm_config_t config = NRFX_PWM_DEFAULT_CONFIG(PWM_PIN,
														NRFX_PWM_PIN_NOT_USED,
														NRFX_PWM_PIN_NOT_USED,
														NRFX_PWM_PIN_NOT_USED);
	config.base_clock = NRF_PWM_CLK_8MHz;
	config.top_value  = TICKS_PER_PERIOD;
	config.load_mode  = NRF_PWM_LOAD_COMMON;

    IRQ_CONNECT(DT_IRQN(DT_INST(0, nordic_nrf_pwm)),
            DT_IRQ(DT_INST(0, nordic_nrf_pwm), priority),
            nrfx_isr,
            nrfx_pwm_0_irq_handler,
            0);
	return nrfx_pwm_init(&m_pwm, &config, m_pwm_handler, NULL);
}

static void m_blast(uint32_t refresh_count, const uint16_t *data, uint32_t len)
{
    static nrf_pwm_sequence_t m_seq = {
        .values.p_common = NULL,
        .length          = 0,
        .repeats         = 0,
        .end_delay       = 0
    };

    m_seq.repeats         = refresh_count;
    m_seq.values.p_common = data;
    m_seq.length          = len;
    nrfx_pwm_simple_playback(&m_pwm,
                             &m_seq,
                             1,
                             NRFX_PWM_FLAG_STOP);
}

void main(void)
{
	nrfx_err_t nrfx_err;

	m_configure_gpio();

	nrfx_err = m_pwm_config();
	if (NRFX_SUCCESS != nrfx_err) {
		LOG_ERR("PWM config failed: %x", nrfx_err);
		dk_set_led_on(DK_LED2);
	}

	LOG_INF("Turret started.");

	while (true) {
		int             err;
		uint32_t        refresh_count;
		const uint16_t *data;
		uint32_t        len;

		err = dynasty_cmd_get(DYNASTY_TEAM_BLUE, DYNASTY_WEAPON_PISTOL, &refresh_count, &data, &len);
		if (err) {
			LOG_ERR("dynasty_cmd_get failed: %d", err);
		}
		m_blast(refresh_count, data, len);

		dk_set_led_on(DK_LED1);
		k_sleep(K_MSEC(200));

		err = laser_x_cmd_get(LASER_X_TEAM_BLUE, &refresh_count, &data, &len);
		if (err) {
			LOG_ERR("laser_x_cmd_get failed: %d", err);
		}
		m_blast(refresh_count, data, len);

 		dk_set_led_off(DK_LED1);
		k_sleep(K_MSEC(200));
	}
}
```

## include/dynasty.h
```c
/*
 * Copyright (c) 2020 Daniel Veilleux
 */

#ifndef DYNASTY_H__
#define DYNASTY_H__

#ifdef __cplusplus
extern "C" {
#endif

/*
 * Empirical measurements:
 *
 * Preamble:   ~1.6ms
 * Short high: [0.36, 0.41]ms
 * Long high:  [0.72, 0.75]ms
 * Short low:  [0.40, 0.44]ms
 * Long low:   [0.74, 0.8]ms
 * ------------------------------
 * Total length is [20.0, 20.8]ms
 */

#define DYNASTY_HP							9

#define DYNASTY_PISTOL_SHOT_COUNT			12
#define DYNASTY_SHOTGUN_MACHINE_GUN_COUNT	6
#define DYNASTY_ROCKET_COUNT				1

#define DYNASTY_PISTOL_DAMAGE				1
#define DYNASTY_SHOTGUN_MACHINE_GUN_DAMAGE	2
#define DYNASTY_ROCKET_DAMAGE				3

enum dynasty_team {
	DYNASTY_TEAM_RED,
	DYNASTY_TEAM_GREEN,
	DYNASTY_TEAM_BLUE,
	DYNASTY_TEAM_WHITE,
	DYNASTY_TEAM_COUNT
};

enum dynasty_weapon {
	DYNASTY_WEAPON_PISTOL,
	DYNASTY_WEAPON_SHOTGUN_MACHINE_GUN,
	DYNASTY_WEAPON_ROCKET,
	DYNASTY_WEAPON_COUNT
};

/**
 * @brief Retrieve the refresh count and data buffer for the given cmd.
 *
 * @retval  0 success
 * @retval -1 invalid cmd
 * @retval 
 */
int dynasty_cmd_get(enum dynasty_team team, enum dynasty_weapon weapon,
	                uint32_t *refresh_count, const uint16_t **buf, uint32_t *len);

#ifdef __cplusplus
}
#endif

#endif /* DYNASTY_H__ */
```

## include/dynasty_toys.h
```c
/*
 * Copyright (c) 2020 Daniel Veilleux
 */

#ifndef DYNASTY_H__
#define DYNASTY_H__

#ifdef __cplusplus
extern "C" {
#endif

/*
 * Empirical measurements:
 *
 * Preamble:       ~1.6ms
 * Short high/low: [0.36, 0.44]ms
 * Long  high/low: [0.72, 0.8]ms
 * ------------------------------
 * Total length:   [20.0, 20.8]ms
 *
 * NOTE: Assumes an 8MHz clock so the 37.9KHz period is ~211 ticks.
 */

#define DYNASTY_HP							9

#define DYNASTY_PISTOL_SHOT_COUNT			12
#define DYNASTY_SHOTGUN_MACHINE_GUN_COUNT	6
#define DYNASTY_ROCKET_COUNT				1

#define DYNASTY_PISTOL_DAMAGE				1
#define DYNASTY_SHOTGUN_MACHINE_GUN_DAMAGE	2
#define DYNASTY_ROCKET_DAMAGE				3

enum dynasty_team {
	DYNASTY_TEAM_RED,
	DYNASTY_TEAM_GREEN,
	DYNASTY_TEAM_BLUE,
	DYNASTY_TEAM_WHITE,
	DYNASTY_TEAM_COUNT
};

enum dynasty_weapon {
	DYNASTY_WEAPON_PISTOL,
	DYNASTY_WEAPON_SHOTGUN_MACHINE_GUN,
	DYNASTY_WEAPON_ROCKET,
	DYNASTY_WEAPON_COUNT
};

/**
 * @brief Retrieve the refresh count and data buffer for the given cmd.
 *
 * @retval  0 success
 * @retval -1 invalid cmd
 * @retval 
 */
int dynasty_cmd_get(enum dynasty_team team, enum dynasty_weapon weapon,
	                uint32_t *refresh_count, const uint16_t **buf, uint32_t *len);

#ifdef __cplusplus
}
#endif

#endif /* DYNASTY_H__ */
```

## include/laser_x.h
```c
/*
 * Copyright (c) 2020 Daniel Veilleux
 */

#ifndef LASER_X_H__
#define LASER_X_H__

#ifdef __cplusplus
extern "C" {
#endif

/*
 * Empirical measurements:
 *
 * Preamble:     ~6ms
 * Short high    [0.40, 0.48]ms
 * Short low:    [0.52, 0.57]ms
 * Long low:     [1.47, 1.56]ms
 * ------------------------------
 * Total length: [16.7, 17.6]ms
 *
 * NOTE: Assumes an 8MHz clock so the 37.9KHz period is ~211 ticks.
 */

/* NOTE: Blasters regenerate 1 hitpoint per minute if they are not shot. */
#define LASER_X_HP		8

#define LASER_X_DAMAGE	1

enum laser_x_team {
	LASER_X_TEAM_RED,
	LASER_X_TEAM_BLUE,
	LASER_X_TEAM_NEUTRAL, /* Can be shot by any team, including other NEUTRALs	 */
	LASER_X_TEAM_COUNT
};

/**
 * @brief Retrieve the refresh count and data buffer for the given cmd.
 *
 * @retval  0 success
 * @retval -1 invalid cmd
 * @retval 
 */
int laser_x_cmd_get(enum laser_x_team team,
	                uint32_t *refresh_count, const uint16_t **buf, uint32_t *len);

#ifdef __cplusplus
}
#endif

#endif /* LASER_X_H__ */
```

## src/dynasty.c
```c
/*
 * Copyright (c) 2020 Daniel Veilleux
 */
#include <zephyr.h>

#include <nrfx_pwm.h>

#include "dynasty.h"

/*
 * Dynasty Toys laser tag blaster IR codes
 */
#define TICKS_PER_PERIOD    211
#define DUTY_CYCLE_0        TICKS_PER_PERIOD
#define DUTY_CYCLE_50       (TICKS_PER_PERIOD / 2)
#define REFRESH_COUNT_400US 15

#define PREAMBLE DUTY_CYCLE_50,DUTY_CYCLE_50,DUTY_CYCLE_50,DUTY_CYCLE_50
#define SHORT_1  DUTY_CYCLE_50
#define LONG_1   DUTY_CYCLE_50,DUTY_CYCLE_50
#define SHORT_0  DUTY_CYCLE_0
#define LONG_0   DUTY_CYCLE_0,DUTY_CYCLE_0
#define SS       SHORT_0,SHORT_1
#define SL       SHORT_0,LONG_1
#define LS       LONG_0,SHORT_1
#define LL       LONG_0,LONG_1
#define PREFIX   PREAMBLE,SS,SS,SS,SS,LS,LS,LS,LS
#define END      DUTY_CYCLE_0

/*
 * NOTE: These values must be in RAM due to EasyDMA limitations.
 */
static uint16_t RED_PISTOL[]  = {PREFIX,SS,SS,SS,LS,SS,SS,SS,SL,SS,SS,SL,LL,END};
static uint16_t RED_SHOTGUN[] = {PREFIX,SS,SS,SS,LS,SS,SS,SS,LS,SS,SS,LS,SS,END};
static uint16_t RED_ROCKET[]  = {PREFIX,SS,SS,SS,LS,SS,SS,SS,LL,SS,SS,LS,SL,END};

static uint16_t GREEN_PISTOL[]  = {PREFIX,SS,SS,SS,LL,SS,SS,SS,SL,SS,SS,LS,SS,END};
static uint16_t GREEN_SHOTGUN[] = {PREFIX,SS,SS,SS,LL,SS,SS,SS,LS,SS,SS,LS,SL,END};
static uint16_t GREEN_ROCKET[]  = {PREFIX,SS,SS,SS,LL,SS,SS,SS,LL,SS,SS,LS,LL,END};

static uint16_t BLUE_PISTOL[]  = {PREFIX,SS,SS,SS,SL,SS,SS,SS,SL,SS,SS,SL,LS,END};
static uint16_t BLUE_SHOTGUN[] = {PREFIX,SS,SS,SS,SL,SS,SS,SS,LS,SS,SS,SL,LL,END};
static uint16_t BLUE_ROCKET[]  = {PREFIX,SS,SS,SS,SL,SS,SS,SS,LL,SS,SS,LS,SS,END};

static uint16_t WHITE_PISTOL[]  = {PREFIX,SS,SS,SL,SS,SS,SS,SS,SL,SS,SS,LS,SL,END};
static uint16_t WHITE_SHOTGUN[] = {PREFIX,SS,SS,SL,SS,SS,SS,SS,LS,SS,SS,LS,LL,END};
static uint16_t WHITE_ROCKET[]  = {PREFIX,SS,SS,SL,SS,SS,SS,SS,LL,SS,SS,LL,SS,END};

int dynasty_cmd_get(enum dynasty_team team, enum dynasty_weapon weapon,
                    uint32_t *refresh_count, const uint16_t **buf, uint32_t *len)
{
    switch (team) {
    case DYNASTY_TEAM_RED:
        switch (weapon) {
        case DYNASTY_WEAPON_PISTOL:
            *buf = &RED_PISTOL[0];
            *len = NRF_PWM_VALUES_LENGTH(RED_PISTOL);
            break;
        case DYNASTY_WEAPON_SHOTGUN_MACHINE_GUN:
            *buf = &RED_SHOTGUN[0];
            *len = NRF_PWM_VALUES_LENGTH(RED_SHOTGUN);
            break;
        case DYNASTY_WEAPON_ROCKET:
            *buf = &RED_ROCKET[0];
            *len = NRF_PWM_VALUES_LENGTH(RED_ROCKET);
            break;
        default:
            return -1;
        }
        break;
    case DYNASTY_TEAM_GREEN:
        switch (weapon) {
        case DYNASTY_WEAPON_PISTOL:
            *buf = &GREEN_PISTOL[0];
            *len = NRF_PWM_VALUES_LENGTH(GREEN_PISTOL);
            break;
        case DYNASTY_WEAPON_SHOTGUN_MACHINE_GUN:
            *buf = &GREEN_SHOTGUN[0];
            *len = NRF_PWM_VALUES_LENGTH(GREEN_SHOTGUN);
            break;
        case DYNASTY_WEAPON_ROCKET:
            *buf = &GREEN_ROCKET[0];
            *len = NRF_PWM_VALUES_LENGTH(GREEN_ROCKET);
            break;
        default:
            return -1;
        }
        break;
    case DYNASTY_TEAM_BLUE:
        switch (weapon) {
        case DYNASTY_WEAPON_PISTOL:
            *buf = &BLUE_PISTOL[0];
            *len = NRF_PWM_VALUES_LENGTH(BLUE_PISTOL);
            break;
        case DYNASTY_WEAPON_SHOTGUN_MACHINE_GUN:
            *buf = &BLUE_SHOTGUN[0];
            *len = NRF_PWM_VALUES_LENGTH(BLUE_SHOTGUN);
            break;
        case DYNASTY_WEAPON_ROCKET:
            *buf = &BLUE_ROCKET[0];
            *len = NRF_PWM_VALUES_LENGTH(BLUE_ROCKET);
            break;
        default:
            return -1;
        }
        break;
    case DYNASTY_TEAM_WHITE:
        switch (weapon) {
        case DYNASTY_WEAPON_PISTOL:
            *buf = &WHITE_PISTOL[0];
            *len = NRF_PWM_VALUES_LENGTH(WHITE_PISTOL);
            break;
        case DYNASTY_WEAPON_SHOTGUN_MACHINE_GUN:
            *buf = &WHITE_SHOTGUN[0];
            *len = NRF_PWM_VALUES_LENGTH(WHITE_SHOTGUN);
            break;
        case DYNASTY_WEAPON_ROCKET:
            *buf = &WHITE_ROCKET[0];
            *len = NRF_PWM_VALUES_LENGTH(WHITE_ROCKET);
            break;
        default:
            return -1;
        }
        break;
    default:
        return -1;
    }
    *refresh_count = REFRESH_COUNT_400US;
    return 0;
}
```

## src/dynasty_toys.c
```c
/*
 * Copyright (c) 2020 Daniel Veilleux
 */
#include <zephyr.h>

#include <nrfx_pwm.h>

#include "dynasty_toys.h"

/*
 * Dynasty Toys laser tag blaster IR codes
 */
#define TICKS_PER_PERIOD    211
#define DUTY_CYCLE_0        TICKS_PER_PERIOD
#define DUTY_CYCLE_50       (TICKS_PER_PERIOD / 2)
#define REFRESH_COUNT_400US 15

#define PREAMBLE DUTY_CYCLE_50,DUTY_CYCLE_50,DUTY_CYCLE_50,DUTY_CYCLE_50
#define SHORT_1  DUTY_CYCLE_50
#define LONG_1   DUTY_CYCLE_50,DUTY_CYCLE_50
#define SHORT_0  DUTY_CYCLE_0
#define LONG_0   DUTY_CYCLE_0,DUTY_CYCLE_0
#define SS       SHORT_0,SHORT_1
#define SL       SHORT_0,LONG_1
#define LS       LONG_0,SHORT_1
#define LL       LONG_0,LONG_1
#define PREFIX   PREAMBLE,SS,SS,SS,SS,LS,LS,LS,LS
#define END      SHORT_0

/*
 * NOTE: These values must be in RAM due to EasyDMA limitations.
 */
static uint16_t RED_PISTOL[]  = {PREFIX,SS,SS,SS,LS,SS,SS,SS,SL,SS,SS,SL,LL,END};
static uint16_t RED_SHOTGUN[] = {PREFIX,SS,SS,SS,LS,SS,SS,SS,LS,SS,SS,LS,SS,END};
static uint16_t RED_ROCKET[]  = {PREFIX,SS,SS,SS,LS,SS,SS,SS,LL,SS,SS,LS,SL,END};

static uint16_t GREEN_PISTOL[]  = {PREFIX,SS,SS,SS,LL,SS,SS,SS,SL,SS,SS,LS,SS,END};
static uint16_t GREEN_SHOTGUN[] = {PREFIX,SS,SS,SS,LL,SS,SS,SS,LS,SS,SS,LS,SL,END};
static uint16_t GREEN_ROCKET[]  = {PREFIX,SS,SS,SS,LL,SS,SS,SS,LL,SS,SS,LS,LL,END};

static uint16_t BLUE_PISTOL[]  = {PREFIX,SS,SS,SS,SL,SS,SS,SS,SL,SS,SS,SL,LS,END};
static uint16_t BLUE_SHOTGUN[] = {PREFIX,SS,SS,SS,SL,SS,SS,SS,LS,SS,SS,SL,LL,END};
static uint16_t BLUE_ROCKET[]  = {PREFIX,SS,SS,SS,SL,SS,SS,SS,LL,SS,SS,LS,SS,END};

static uint16_t WHITE_PISTOL[]  = {PREFIX,SS,SS,SL,SS,SS,SS,SS,SL,SS,SS,LS,SL,END};
static uint16_t WHITE_SHOTGUN[] = {PREFIX,SS,SS,SL,SS,SS,SS,SS,LS,SS,SS,LS,LL,END};
static uint16_t WHITE_ROCKET[]  = {PREFIX,SS,SS,SL,SS,SS,SS,SS,LL,SS,SS,LL,SS,END};

int dynasty_cmd_get(enum dynasty_team team, enum dynasty_weapon weapon,
                    uint32_t *refresh_count, const uint16_t **buf, uint32_t *len)
{
    switch (team) {
    case DYNASTY_TEAM_RED:
        switch (weapon) {
        case DYNASTY_WEAPON_PISTOL:
            *buf = &RED_PISTOL[0];
            *len = NRF_PWM_VALUES_LENGTH(RED_PISTOL);
            break;
        case DYNASTY_WEAPON_SHOTGUN_MACHINE_GUN:
            *buf = &RED_SHOTGUN[0];
            *len = NRF_PWM_VALUES_LENGTH(RED_SHOTGUN);
            break;
        case DYNASTY_WEAPON_ROCKET:
            *buf = &RED_ROCKET[0];
            *len = NRF_PWM_VALUES_LENGTH(RED_ROCKET);
            break;
        default:
            return -1;
        }
        break;
    case DYNASTY_TEAM_GREEN:
        switch (weapon) {
        case DYNASTY_WEAPON_PISTOL:
            *buf = &GREEN_PISTOL[0];
            *len = NRF_PWM_VALUES_LENGTH(GREEN_PISTOL);
            break;
        case DYNASTY_WEAPON_SHOTGUN_MACHINE_GUN:
            *buf = &GREEN_SHOTGUN[0];
            *len = NRF_PWM_VALUES_LENGTH(GREEN_SHOTGUN);
            break;
        case DYNASTY_WEAPON_ROCKET:
            *buf = &GREEN_ROCKET[0];
            *len = NRF_PWM_VALUES_LENGTH(GREEN_ROCKET);
            break;
        default:
            return -1;
        }
        break;
    case DYNASTY_TEAM_BLUE:
        switch (weapon) {
        case DYNASTY_WEAPON_PISTOL:
            *buf = &BLUE_PISTOL[0];
            *len = NRF_PWM_VALUES_LENGTH(BLUE_PISTOL);
            break;
        case DYNASTY_WEAPON_SHOTGUN_MACHINE_GUN:
            *buf = &BLUE_SHOTGUN[0];
            *len = NRF_PWM_VALUES_LENGTH(BLUE_SHOTGUN);
            break;
        case DYNASTY_WEAPON_ROCKET:
            *buf = &BLUE_ROCKET[0];
            *len = NRF_PWM_VALUES_LENGTH(BLUE_ROCKET);
            break;
        default:
            return -1;
        }
        break;
    case DYNASTY_TEAM_WHITE:
        switch (weapon) {
        case DYNASTY_WEAPON_PISTOL:
            *buf = &WHITE_PISTOL[0];
            *len = NRF_PWM_VALUES_LENGTH(WHITE_PISTOL);
            break;
        case DYNASTY_WEAPON_SHOTGUN_MACHINE_GUN:
            *buf = &WHITE_SHOTGUN[0];
            *len = NRF_PWM_VALUES_LENGTH(WHITE_SHOTGUN);
            break;
        case DYNASTY_WEAPON_ROCKET:
            *buf = &WHITE_ROCKET[0];
            *len = NRF_PWM_VALUES_LENGTH(WHITE_ROCKET);
            break;
        default:
            return -1;
        }
        break;
    default:
        return -1;
    }
    *refresh_count = REFRESH_COUNT_400US;
    return 0;
}
```

## src/laser_x.c
```c
/*
 * Copyright (c) 2020 Daniel Veilleux
 */
#include <zephyr.h>

#include <nrfx_pwm.h>

#include "laser_x.h"

/*
 * Dynasty laser tag blaster IR codes.
 */
#define TICKS_PER_PERIOD    211
#define DUTY_CYCLE_0        TICKS_PER_PERIOD
#define DUTY_CYCLE_50       (TICKS_PER_PERIOD / 2)
#define REFRESH_COUNT_5US   18

#define PREAMBLE DUTY_CYCLE_50,DUTY_CYCLE_50,DUTY_CYCLE_50,DUTY_CYCLE_50, \
                 DUTY_CYCLE_50,DUTY_CYCLE_50,DUTY_CYCLE_50,DUTY_CYCLE_50, \
                 DUTY_CYCLE_50,DUTY_CYCLE_50,DUTY_CYCLE_50,DUTY_CYCLE_50
#define SHORT_1  DUTY_CYCLE_50
#define LONG_1   DUTY_CYCLE_50,DUTY_CYCLE_50,DUTY_CYCLE_50
#define SHORT_0  DUTY_CYCLE_0
#define SS       SHORT_0,SHORT_1
#define SL       SHORT_0,LONG_1
#define PREFIX   PREAMBLE,SS,SL,SS,SL,SS,SS
#define END      SHORT_0

/*
 * NOTE: These values must be in RAM due to EasyDMA limitations.
 */
static uint16_t BLUE[]    = {PREFIX,SS,SL,END};
static uint16_t RED[]     = {PREFIX,SL,SS,END};
static uint16_t NEUTRAL[] = {PREFIX,SL,SL,END};

int laser_x_cmd_get(enum laser_x_team team,
                    uint32_t *refresh_count, const uint16_t **buf, uint32_t *len)
{
    switch (team) {
    case LASER_X_TEAM_RED:
        *buf = &RED[0];
        *len = NRF_PWM_VALUES_LENGTH(RED);
        break;
    case LASER_X_TEAM_BLUE:
        *buf = &BLUE[0];
        *len = NRF_PWM_VALUES_LENGTH(BLUE);
        break;
    case LASER_X_TEAM_NEUTRAL:
        *buf = &NEUTRAL[0];
        *len = NRF_PWM_VALUES_LENGTH(NEUTRAL);
        break;
    default:
        return -1;
    }
    *refresh_count = REFRESH_COUNT_5US;
    return 0;
}
```
