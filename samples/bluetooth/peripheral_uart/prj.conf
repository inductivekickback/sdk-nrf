## CMakeLists.txt
```
#
# Copyright (c) 2018 Nordic Semiconductor
#
# SPDX-License-Identifier: LicenseRef-Nordic-5-Clause
#
cmake_minimum_required(VERSION 3.13.1)

find_package(Zephyr REQUIRED HINTS $ENV{ZEPHYR_BASE})
project(NONE)

# NORDIC SDK APP START
FILE(GLOB app_sources src/*.c)
target_sources(app PRIVATE ${app_sources})
# NORDIC SDK APP END

zephyr_library_include_directories(.)
```

## prj.conf
```kconfig
#
# Copyright (c) 2018 Nordic Semiconductor
#
# SPDX-License-Identifier: LicenseRef-Nordic-5-Clause
#

# Disable the UART and console
CONFIG_UART_ASYNC_API=n
CONFIG_NRFX_UARTE0=n
CONFIG_SERIAL=n
CONFIG_CONSOLE=n
CONFIG_UART_CONSOLE=n

CONFIG_GPIO=y

CONFIG_BT=y
CONFIG_BT_PERIPHERAL=y
CONFIG_BT_DEVICE_NAME="Nordic_UART_Service"
CONFIG_BT_DEVICE_APPEARANCE=833
CONFIG_BT_MAX_CONN=1
CONFIG_BT_MAX_PAIRED=1

# Enable the NUS service
CONFIG_BT_NUS=y

# Disable bonding
CONFIG_BT_SETTINGS=n
CONFIG_FLASH=n
CONFIG_FLASH_PAGE_LAYOUT=n
CONFIG_FLASH_MAP=n
CONFIG_NVS=n
CONFIG_SETTINGS=n

# Config logger
CONFIG_LOG=y
CONFIG_USE_SEGGER_RTT=y
CONFIG_LOG_BACKEND_RTT=y
CONFIG_LOG_BACKEND_UART=n
CONFIG_LOG_BUFFER_SIZE=2048
CONFIG_LOG_DEFAULT_LEVEL=3

# Include memory sizes here for easy access
CONFIG_HEAP_MEM_POOL_SIZE=4096
CONFIG_SDC_RX_STACK_SIZE=1024
CONFIG_BT_RX_STACK_SIZE=1024
CONFIG_SYSTEM_WORKQUEUE_STACK_SIZE=2048
CONFIG_MPSL_SIGNAL_STACK_SIZE=1024
CONFIG_MAIN_STACK_SIZE=3072
CONFIG_IDLE_STACK_SIZE=320
CONFIG_ISR_STACK_SIZE=2048

# Configure MPSL
CONFIG_MPSL_LOG_LEVEL_DBG=y
CONFIG_MPSL_TIMESLOT_SESSION_COUNT=1
CONFIG_SDC_MAX_CONN_EVENT_LEN_DEFAULT=4500

CONFIG_THREAD_ANALYZER=y
CONFIG_THREAD_NAME=y

CONFIG_DEBUG_OPTIMIZATIONS=n
CONFIG_SIZE_OPTIMIZATIONS=n
CONFIG_ASSERT=y
CONFIG_DEBUG=y
CONFIG_TIMESLICING=n
```

## src/main.c
```c
/*
 * Copyright (c) 2018 Nordic Semiconductor ASA
 *
 * SPDX-License-Identifier: LicenseRef-Nordic-5-Clause
 */

/** @file
 *  @brief Nordic UART Bridge Service (NUS) sample
 */

#include <stdio.h>
#include <zephyr/types.h>
#include <zephyr.h>
#include <drivers/uart.h>

#include <device.h>
#include <soc.h>

#include <bluetooth/bluetooth.h>
#include <bluetooth/uuid.h>
#include <bluetooth/gatt.h>
#include <bluetooth/hci.h>
#include <bluetooth/services/nus.h>

#include <settings/settings.h>

#include <logging/log.h>

#include <timeslot.h>
#include <proprietary_rf.h>

#define LOG_MODULE_NAME peripheral_uart
LOG_MODULE_REGISTER(LOG_MODULE_NAME);

#define DESIRED_CONN_INTERVAL 28

#define DEVICE_NAME CONFIG_BT_DEVICE_NAME
#define DEVICE_NAME_LEN (sizeof(DEVICE_NAME) - 1)

static struct bt_conn *current_conn;
static struct bt_conn *auth_conn;

static bool nus_ready;
static bool timeslot_running;

static struct timeslot_config timeslot_config = TS_DEFAULT_CONFIG;

static const struct bt_data ad[] = {
    BT_DATA_BYTES(BT_DATA_FLAGS, (BT_LE_AD_GENERAL | BT_LE_AD_NO_BREDR)),
    BT_DATA(BT_DATA_NAME_COMPLETE, DEVICE_NAME, DEVICE_NAME_LEN),
};

static const struct bt_data sd[] = {
    BT_DATA_BYTES(BT_DATA_UUID128_ALL, BT_UUID_NUS_VAL),
};

void error(void)
{
    LOG_ERR("Error handler");
    while (true) {
        /* Spin for ever */
        k_sleep(K_MSEC(1000));
    }
}

static void connected(struct bt_conn *conn, uint8_t err)
{
    char addr[BT_ADDR_LE_STR_LEN];

    if (err) {
        LOG_ERR("Connection failed (err %u)", err);
        return;
    }

    bt_addr_le_to_str(bt_conn_get_dst(conn), addr, sizeof(addr));
    LOG_INF("Connected %s", log_strdup(addr));

    current_conn = bt_conn_ref(conn);
}

static void disconnected(struct bt_conn *conn, uint8_t reason)
{
    char addr[BT_ADDR_LE_STR_LEN];

    bt_addr_le_to_str(bt_conn_get_dst(conn), addr, sizeof(addr));

    LOG_INF("Disconnected: %s (reason %u)", log_strdup(addr), reason);

    if (auth_conn) {
        bt_conn_unref(auth_conn);
        auth_conn = NULL;
    }

    if (current_conn) {
        bt_conn_unref(current_conn);
        current_conn = NULL;
    }

    nus_ready = false;
    int err = timeslot_stop();
    if (err) {
        LOG_ERR("timeslot_stop failed (err=%d)", err);
        error();
    }
}

static void conn_param_updated(struct bt_conn *conn, uint16_t interval,
                 uint16_t latency, uint16_t timeout)
{
    /* NOTE: This may be called multiple times at the beginning of the connection. */
    LOG_INF("Connection params updated: (interval=%d, SL=%d, timeout=%d)",
                interval, latency, timeout);
    int err;

    if (DESIRED_CONN_INTERVAL != interval) {
        LOG_INF("Requesting new Connection Interval");
        struct bt_le_conn_param param = {
            .interval_min = DESIRED_CONN_INTERVAL,
            .interval_max = DESIRED_CONN_INTERVAL,
            .latency = latency,
            .timeout = timeout,
        };

        err = bt_conn_le_param_update(conn, &param);
        if (err == -EALREADY) {
            /* Connection parameters are already set. */
            err = 0;
        }
        if (err) {
            LOG_ERR("bt_conn_le_param_update failed (err=%d)", err);
        }
    } else {
        if (!timeslot_running) {
            err = timeslot_start(TS_LEN_US);
            if (err) {
                LOG_ERR("timeslot_start failed (err=%d)", err);
            } else {
                timeslot_running = true;
            }
        }        
    }
}

static struct bt_conn_cb conn_callbacks = {
    .connected        = connected,
    .disconnected     = disconnected,
    .le_param_updated = conn_param_updated,
};

static void bt_receive_cb(struct bt_conn *conn, const uint8_t *const data,
              uint16_t len)
{
    char addr[BT_ADDR_LE_STR_LEN] = {0};

    bt_addr_le_to_str(bt_conn_get_dst(conn), addr, ARRAY_SIZE(addr));

    LOG_INF("Received data from: %s", log_strdup(addr));
}

static void bt_nus_enabled_cb(enum bt_nus_send_status status)
{
    switch (status) {
    case BT_NUS_SEND_STATUS_ENABLED:
        LOG_INF("NUS TX CCCD enabled");
        nus_ready = true;
        break;
    case BT_NUS_SEND_STATUS_DISABLED:
        LOG_INF("NUX TX CCCD disabled");
        nus_ready = false;
        break;
    default:
        break;
    }
}

static struct bt_nus_cb nus_cb = {
    .received     = bt_receive_cb,
    .send_enabled = bt_nus_enabled_cb,
};

static void timeslot_err_cb(int err)
{
    LOG_ERR("Timeslot session error: %d", err);
}

static void timeslot_start_cb(void)
{
    proprietary_rf_start();
}

static void timeslot_end_cb(void)
{
    proprietary_rf_end();
}

static void timeslot_skipped_cb(uint8_t count)
{
    proprietary_rf_skipped(count);
}

static void timeslot_stopped_cb(void)
{
    LOG_INF("Timeslot stopped");
    timeslot_running  = false;
}

#if !TIMESLOT_CALLS_RADIO_IRQHANDLER
static void radio_irq_cb(void)
{
    LOG_DBG("Radio_IRQHandler");
}
#endif

static struct timeslot_cb timeslot_callbacks = {
    .error     = timeslot_err_cb,
    .start     = timeslot_start_cb,
    .end       = timeslot_end_cb,
    .skipped   = timeslot_skipped_cb,
    .stopped   = timeslot_stopped_cb,
#if !TIMESLOT_CALLS_RADIO_IRQHANDLER
    .radio_irq = radio_irq_cb
#endif
};

void main(void)
{
    int err = 0;

    bt_conn_cb_register(&conn_callbacks);

    err = timeslot_open(&timeslot_config, &timeslot_callbacks);
    if (err) {
        LOG_ERR("timeslot_open failed (err: %d)", err);
        error();
    }

    err = bt_enable(NULL);
    if (err) {
        LOG_ERR("bt_enable failed (err: %d)", err);
        error();
    }

    LOG_INF("Bluetooth initialized");

    if (IS_ENABLED(CONFIG_SETTINGS)) {
        settings_load();
    }

    err = bt_nus_init(&nus_cb);
    if (err) {
        LOG_ERR("Failed to initialize UART service (err: %d)", err);
        error();
    }

    err = bt_le_adv_start(BT_LE_ADV_CONN, ad, ARRAY_SIZE(ad), sd, ARRAY_SIZE(sd));
    if (err) {
        LOG_ERR("Advertising failed to start (err %d)", err);
        error();
    }

    for (;;) {
        k_sleep(K_MSEC(500));
    }
}
```

## include/proprietary_rf.h
```c
/*
 * Copyright (c) 2021 Daniel Veilleux
 *
 * SPDX-License-Identifier: LicenseRef-Nordic-5-Clause
 */

#ifndef PROPRIETARY_RF_H__
#define PROPRIETARY_RF_H__

#ifdef __cplusplus
extern "C" {
#endif

#include <esb.h>

/* The timeslot length to request once per Connection Interval. Will not be extended. */
#define TS_LEN_US 25000

/** @brief A timeslot has ended.
 *
 * @note The timeslot will close safety_margin_us earlier than TS_LEN_US.
 */
void proprietary_rf_end(void);

/** @brief A timeslot was blocked or cancelled.
 * 
 * @note Provided in case the network requires synchnronization, e.g. for channel hopping.
 * 
 * @param[in] count    The number of consecutive skipped timeslots
 */
void proprietary_rf_skipped(uint8_t count);

/* @brief A timeslot has started. */
void proprietary_rf_start(void);

#ifdef __cplusplus
}
#endif

#endif /* PROPRIETARY_RF_H__ */

/** @} */
```

## include/timeslot.h
```c
/*
 * Copyright (c) 2021 Daniel Veilleux
 *
 * SPDX-License-Identifier: LicenseRef-Nordic-5-Clause
 */

#ifndef TIMESLOT_H__
#define TIMESLOT_H__

#ifdef __cplusplus
extern "C" {
#endif

#include <mpsl_timeslot.h>

#define TS_LEN_US               25000
#define TS_RNH_DISTANCE_US      800
#define TS_REQUEST_DELAY_US     2600

/**
 * A hardware interrupt vector to use with the Radio Notification feature as well as lowering the
 * priority of the MPSL callback (Zero Latency IRQ workaround). As of NCS v1.6.0 this doesn't
 * handle MPSL_TIMESLOT_SIGNAL_TIMER0 signals correctly unless it uses priority 4 or higher.
 */
#define TIMESLOT_IRQN          QDEC_IRQn
#define TIMESLOT_IRQ_NODELABEL qdec
#define TIMESLOT_IRQ_PRIO      4

/**
 * If TIMESLOT_CALLS_RADIO_IRQHANDLER is set then RADIO_IRQHandler() will be called
 * directly instead of executing the radio_irq callback.
 */
#define TIMESLOT_CALLS_RADIO_IRQHANDLER 1

enum TIMESLOT_ERROR
{
    /**
     * Could not get a granted timeslot using an "earliest" request. len_us is probably
     * too long for the current Connection Interval.
     */
    TIMESLOT_ERROR_REQUESTS_FAILED = 94,
    /** The MPSL complained because the timeslot did not close on time. */
    TIMESLOT_ERROR_OVERSTAYED = 93,
    /** Something unexpected happened. */
    TIMESLOT_ERROR_INTERNAL = 92,
    /** The timeslot_open function was called twice. */
    TIMESLOT_ERROR_SESSION_ALREADY_OPENED = 91,
    /**
     * The timeslot_start function was called before timeslot_stop completed (and executed
     * the stopped callback).
     */
    TIMESLOT_ERROR_TIMESLOT_ALREADY_STARTED = 90,
    /** The timeslot_stop function was called twice. */
    TIMESLOT_ERROR_NO_TIMESLOT_STARTED = 89,
    /** A required pointer was not included in an argument. */
    TIMESLOT_ERROR_INVALID_PARAM = 88
};

struct timeslot_config {
    /**
     * High frequency clock source, see MPSL_TIMESLOT_HFCLK_CFG.
     */
    uint8_t  hfclk;        
    /**
     * Amount of time before a request times out.
     */
    uint32_t timeout_us;
    /**
     * Close the timeslot this amount of time before the end to ensure that it closes cleanly.
     */
    uint32_t  safety_margin_us;
    /**
     * The number of skipped timeslots before an error is raised.
     */
    uint8_t   skipped_tolerance;
};

#define TS_DEFAULT_CONFIG { \
    .hfclk             = MPSL_TIMESLOT_HFCLK_CFG_XTAL_GUARANTEED, \
    .timeout_us        = 2000000, /* Default is 2s. */            \
    .safety_margin_us  = 100, /* Default is 100us */              \
    .skipped_tolerance = 5 /* Default is 5 */                     \
}

struct timeslot_cb {
    /**
     * A (potentially unrecoverable) error has occurred. The err param will be set to a
     * TIMESLOT_ERROR or an error returned by mpsl_timeslot_request.
     */
    void (*error)(int err);
    /**
     * Called at the beginning of every timeslot.
     */
    void (*start)(void);
    /**
     * Called TS_SAFETY_MARGIN_US before the end of every timeslot.
     */
    void (*end)(void);
    /**
     * A timeslot has been blocked or cancelled. The count parameter is set to the number
     * of consecutive timeslots that have been skipped.
     */
    void (*skipped)(uint8_t count);
    /**
     * The recurring timeslot has been stopped (the session is idle).
     */
    void (*stopped)(void);

#if !TIMESLOT_USE_RADIO_IRQHANDLER
    /**
     * Some like e.g. the ESB library defines its own RADIO_IRQHandler function. Setting
     * TIMESLOT_USE_RADIO_IRQHANDLER causes MPSL_TIMESLOT_SIGNAL_RADIO signals to call
     * RADIO_IRQHandler directly. Otherwise, this callback will be used whenever RADIO_IRQHandler
     * is called.
     */
    void (*radio_irq)(void);
#endif
};

/** @brief Open an MPSL session
 * 
 * @note Opening a session is always the first step and closing a session is not implemented
 *       because there's no obvious reason to ever do it.
 * 
 * @param[in] p_config      Pointer to a timeslot_config (should be static/global)
 * @param[in] p_cb          Pointer to a timeslot_cb (should be static/global)
 * 
 * @retval 0                                      Success
 * @retval -TIMESLOT_ERROR_SESSION_ALREADY_OPENED The session is already open
 * @retval -TIMESLOT_ERROR_INVALID_PARAM          One of the pointers was NULL
 */
int timeslot_open(struct timeslot_config *p_config, struct timeslot_cb *p_cb);

/** @brief Request a recurring timeslot of len_us based on the given interval
 * 
 * @param[in] len_us      Usable length will be minus safety_margin_us
 * 
 * @retval 0                                        Success
 * @retval -TIMESLOT_ERROR_TIMESLOT_ALREADY_STARTED The session is already open
 * @retval -NRF_EINVAL                              Invalid parameter
 * @retval -NRF_ENOENT                              The session is not open
 * @retval -NRF_EAGAIN                              The session is not IDLE
 */
int timeslot_start(uint32_t len_us);

/** @brief Stop requesting the recurring timeslot and allow the session to go idle
 *
 * @retval 0                                   Success
 * @retval -TIMESLOT_ERROR_NO_TIMESLOT_STARTED There is no timeslot to stop
 */
int timeslot_stop(void);

#ifdef __cplusplus
}
#endif

#endif /* TIMESLOT_H__ */

/** @} */
```

## src/proprietary_rf.c
```c
#include <zephyr.h>
#include <drivers/gpio.h>

#include <proprietary_rf.h>

#include <logging/log.h>

#define LOG_MODULE_NAME proprietary_rf
LOG_MODULE_REGISTER(LOG_MODULE_NAME);

static const struct device *led_port;
static struct esb_payload   rx_payload;
static bool                 ready      = true;
static struct esb_payload   tx_payload = ESB_CREATE_PAYLOAD(0x00, 0x01, 0x00, 0x03,
                                                            0x04, 0x05, 0x06, 0x07, 0x08);

static void esb_cb(struct esb_evt const *event)
{
    ready = true;

    switch (event->evt_id) {
    case ESB_EVENT_TX_SUCCESS:
        LOG_INF("ESB TX SUCCESS EVENT");
        break;
    case ESB_EVENT_TX_FAILED:
        LOG_INF("ESB TX FAILED EVENT");
        break;
    case ESB_EVENT_RX_RECEIVED:
        while (esb_read_rx_payload(&rx_payload) == 0) {
            LOG_INF("Packet received, len %d : "
                "0x%02x, 0x%02x, 0x%02x, 0x%02x, "
                "0x%02x, 0x%02x, 0x%02x, 0x%02x",
                rx_payload.length, rx_payload.data[0],
                rx_payload.data[1], rx_payload.data[2],
                rx_payload.data[3], rx_payload.data[4],
                rx_payload.data[5], rx_payload.data[6],
                rx_payload.data[7]);
        }
        break;
    }
}

static int esb_initialize(void)
{
    int err;
    /* These are arbitrary default addresses. In end user products
     * different addresses should be used for each set of devices.
     */
    uint8_t base_addr_0[4] = {0xE7, 0xE7, 0xE7, 0xE7};
    uint8_t base_addr_1[4] = {0xC2, 0xC2, 0xC2, 0xC2};
    uint8_t addr_prefix[8] = {0xE7, 0xC2, 0xC3, 0xC4, 0xC5, 0xC6, 0xC7, 0xC8};

    struct esb_config config = ESB_DEFAULT_CONFIG;

    config.protocol           = ESB_PROTOCOL_ESB_DPL;
    config.retransmit_delay   = 600;
    config.bitrate            = ESB_BITRATE_2MBPS;
    config.event_handler      = esb_cb;
    config.mode               = ESB_MODE_PTX;
    config.selective_auto_ack = true;

    err = esb_init(&config);

    if (err) {
        return err;
    }

    err = esb_set_base_address_0(base_addr_0);
    if (err) {
        return err;
    }

    err = esb_set_base_address_1(base_addr_1);
    if (err) {
        return err;
    }

    err = esb_set_prefixes(addr_prefix, ARRAY_SIZE(addr_prefix));
    if (err) {
        return err;
    }

    return 0;
}

static int leds_init(void)
{
    led_port = device_get_binding(DT_GPIO_LABEL(DT_ALIAS(led0), gpios));
    if (!led_port) {
        LOG_ERR("Could not bind to LED port %s",
            DT_GPIO_LABEL(DT_ALIAS(led0), gpios));
        return -EIO;
    }

    const uint8_t pins[] = {DT_GPIO_PIN(DT_ALIAS(led0), gpios),
                 DT_GPIO_PIN(DT_ALIAS(led1), gpios),
                 DT_GPIO_PIN(DT_ALIAS(led2), gpios),
                 DT_GPIO_PIN(DT_ALIAS(led3), gpios)};

    for (size_t i = 0; i < ARRAY_SIZE(pins); i++) {
        int err = gpio_pin_configure(led_port, pins[i], GPIO_OUTPUT);

        if (err) {
            LOG_ERR("Unable to configure LED%u, err %d", i, err);
            led_port = NULL;
            return err;
        }
    }

    return 0;
}

static void leds_update(uint8_t value)
{
    bool led0_status = !(value % 8 > 0 && value % 8 <= 4);
    bool led1_status = !(value % 8 > 1 && value % 8 <= 5);
    bool led2_status = !(value % 8 > 2 && value % 8 <= 6);
    bool led3_status = !(value % 8 > 3);

    gpio_port_pins_t mask =
        1 << DT_GPIO_PIN(DT_ALIAS(led0), gpios) |
        1 << DT_GPIO_PIN(DT_ALIAS(led1), gpios) |
        1 << DT_GPIO_PIN(DT_ALIAS(led2), gpios) |
        1 << DT_GPIO_PIN(DT_ALIAS(led3), gpios);

    gpio_port_value_t val =
        led0_status << DT_GPIO_PIN(DT_ALIAS(led0), gpios) |
        led1_status << DT_GPIO_PIN(DT_ALIAS(led1), gpios) |
        led2_status << DT_GPIO_PIN(DT_ALIAS(led2), gpios) |
        led3_status << DT_GPIO_PIN(DT_ALIAS(led3), gpios);

    if (led_port != NULL) {
        (void)gpio_port_set_masked_raw(led_port, mask, val);
    }
}

void proprietary_rf_end(void)
{
    esb_disable();
}

void proprietary_rf_skipped(uint8_t count)
{
    LOG_INF("proprietary_rf_skipped(count=%d)", count);
}

void proprietary_rf_start(void)
{
    int err;

    leds_init();

    err = esb_initialize();
    if (err) {
        LOG_ERR("ESB initialization failed, err %d", err);
        return;
    }

    tx_payload.noack = false;
    if (ready) {
        ready = false;
        esb_flush_tx();
        leds_update(tx_payload.data[1]);

        err = esb_write_payload(&tx_payload);
        if (err) {
            LOG_ERR("Payload write failed, err %d", err);
        }
        tx_payload.data[1]++;
    }
}
```

## src/timeslot.c
```c
/*
 * Copyright (c) 2021 Daniel Veilleux
 *
 * SPDX-License-Identifier: LicenseRef-Nordic-5-Clause
 */

#include <zephyr.h>
#include <stdio.h>

#include <logging/log.h>

#define LOG_MODULE_NAME timeslot
LOG_MODULE_REGISTER(LOG_MODULE_NAME);

#include <mpsl.h>
#include <mpsl_radio_notification.h>
#include <mpsl_timeslot.h>

#define TS_GPIO_DEBUG 1

#if TS_GPIO_DEBUG
#include <hal/nrf_gpio.h>
#define TIMESLOT_OPEN_PIN          4
#define TIMESLOT_BLOCKED_PIN       28
#define TIMESLOT_CANCELLED_PIN     30
#define RADIO_NOTIFICATION_PIN     2
#define REQUEST_PIN                31
#endif

#include <timeslot.h>

#define TIMESLOT_THREAD_STACK_SIZE 768
#define TIMESLOT_THREAD_PRIORITY   5

#define INVALID_MPSL_SIGNAL        11

enum SIGNAL_CODE
{
    SIGNAL_CODE_START             = 0x00,
    SIGNAL_CODE_TIMER0            = 0x01,
    SIGNAL_CODE_RADIO             = 0x02,
    SIGNAL_CODE_BLOCKED_CANCELLED = 0x03,
    SIGNAL_CODE_OVERSTAYED        = 0x04,
    SIGNAL_CODE_IDLE              = 0x05,
    SIGNAL_CODE_RNH_ACTIVE        = 0x06,
    SIGNAL_CODE_UNEXPECTED        = 0x07
};

static uint32_t                ts_len_us;
static uint8_t                 blocked_cancelled_count;
static bool                    session_open;
static bool                    timeslot_started;
static bool                    timeslot_stopping;
static bool                    timeslot_requested;
static uint32_t                mpsl_callback_signal=INVALID_MPSL_SIGNAL;
static struct timeslot_config *p_timeslot_config;
static struct timeslot_cb     *p_timeslot_callbacks;

static struct k_poll_signal timeslot_sig = K_POLL_SIGNAL_INITIALIZER(timeslot_sig);
static struct k_poll_event events[1]     = {
    K_POLL_EVENT_STATIC_INITIALIZER(K_POLL_TYPE_SIGNAL,
                                    K_POLL_MODE_NOTIFY_ONLY,
                                    &timeslot_sig, 0),
};

static mpsl_timeslot_session_id_t mpsl_session_id;

/* NOTE: MPSL return params must be in static scope. */
static mpsl_timeslot_request_t request_earliest = {
    .request_type = MPSL_TIMESLOT_REQ_TYPE_EARLIEST,
    .params.earliest = {
        .priority   = MPSL_TIMESLOT_PRIORITY_NORMAL,
    }
};

static mpsl_timeslot_signal_return_param_t action_none = {
    .callback_action = MPSL_TIMESLOT_SIGNAL_ACTION_NONE
};

static mpsl_timeslot_signal_return_param_t action_end = {
    .callback_action = MPSL_TIMESLOT_SIGNAL_ACTION_END
};

#if TIMESLOT_CALLS_RADIO_IRQHANDLER
void RADIO_IRQHandler(void);
#endif

static mpsl_timeslot_signal_return_param_t*
mpsl_cb(mpsl_timeslot_session_id_t session_id, uint32_t signal)
{
    switch (signal) {
    case MPSL_TIMESLOT_SIGNAL_START:
#if TS_GPIO_DEBUG
        nrf_gpio_pin_write(TIMESLOT_OPEN_PIN, 1);
#endif
        if (timeslot_stopping) {
#if TS_GPIO_DEBUG
            nrf_gpio_pin_write(TIMESLOT_OPEN_PIN, 0);
            nrf_gpio_pin_write(TIMESLOT_OPEN_PIN, 0);
            nrf_gpio_pin_write(TIMESLOT_OPEN_PIN, 0);
            nrf_gpio_pin_write(TIMESLOT_OPEN_PIN, 0);
            nrf_gpio_pin_write(TIMESLOT_OPEN_PIN, 0);
            nrf_gpio_pin_write(TIMESLOT_OPEN_PIN, 0);
            nrf_gpio_pin_write(TIMESLOT_OPEN_PIN, 1);
#endif
            return &action_end;
        }

        /* TIMER0 is pre-configured for 1MHz mode by the MPSL. */
        NRF_TIMER0->CC[0]    = (ts_len_us - p_timeslot_config->safety_margin_us);
        NRF_TIMER0->INTENSET = (TIMER_INTENSET_COMPARE0_Set<<TIMER_INTENSET_COMPARE0_Pos);
        mpsl_callback_signal = MPSL_TIMESLOT_SIGNAL_START;
        NVIC_EnableIRQ(TIMER0_IRQn);
        NVIC_SetPendingIRQ(TIMESLOT_IRQN);
        break;

    case MPSL_TIMESLOT_SIGNAL_TIMER0:
#if TS_GPIO_DEBUG
        nrf_gpio_pin_write(TIMESLOT_OPEN_PIN, 0);
#endif
        NRF_TIMER0->TASKS_STOP = 1;
        mpsl_callback_signal   = MPSL_TIMESLOT_SIGNAL_TIMER0;
        NVIC_SetPendingIRQ(TIMESLOT_IRQN);
        return &action_end;

    case MPSL_TIMESLOT_SIGNAL_RADIO:
        if (timeslot_stopping) {
            return &action_end;
        }
#if TIMESLOT_CALLS_RADIO_IRQHANDLER
        RADIO_IRQHandler();
#else
        mpsl_callback_signal = MPSL_TIMESLOT_SIGNAL_RADIO;
        NVIC_SetPendingIRQ(TIMESLOT_IRQN);
#endif
        break;

    case MPSL_TIMESLOT_SIGNAL_BLOCKED:
#if TS_GPIO_DEBUG
        nrf_gpio_pin_write(TIMESLOT_BLOCKED_PIN, 1);
#endif
        k_poll_signal_raise(&timeslot_sig, SIGNAL_CODE_BLOCKED_CANCELLED);
        break;

    case MPSL_TIMESLOT_SIGNAL_CANCELLED:
#if TS_GPIO_DEBUG
        nrf_gpio_pin_write(TIMESLOT_CANCELLED_PIN, 1);
#endif
        k_poll_signal_raise(&timeslot_sig, SIGNAL_CODE_BLOCKED_CANCELLED);
        break;

    case MPSL_TIMESLOT_SIGNAL_SESSION_IDLE:
        k_poll_signal_raise(&timeslot_sig, SIGNAL_CODE_IDLE);
        break;

    case MPSL_TIMESLOT_SIGNAL_EXTEND_FAILED:
        /* Intentional fall-through */
    case MPSL_TIMESLOT_SIGNAL_EXTEND_SUCCEEDED:
        /* Intentional fall-through */
    case MPSL_TIMESLOT_SIGNAL_INVALID_RETURN:
        /* Intentional fall-through */
    case MPSL_TIMESLOT_SIGNAL_SESSION_CLOSED:
        k_poll_signal_raise(&timeslot_sig, SIGNAL_CODE_UNEXPECTED);
        break;

    case MPSL_TIMESLOT_SIGNAL_OVERSTAYED:
        k_poll_signal_raise(&timeslot_sig, SIGNAL_CODE_OVERSTAYED);
        break;

    default:
        break;
    };

    return &action_none;
}

static void radio_notify_cb(const void *context)
{
    if (!timeslot_started)
    {
        /* Ignore RNH events until the timeslot is started. */
        return;
    }

    if (INVALID_MPSL_SIGNAL != mpsl_callback_signal) {
        /* This is an MPSL callback. */
        switch (mpsl_callback_signal) {
        case MPSL_TIMESLOT_SIGNAL_START:
            k_poll_signal_raise(&timeslot_sig, SIGNAL_CODE_START);
            break;
        case MPSL_TIMESLOT_SIGNAL_RADIO:
            k_poll_signal_raise(&timeslot_sig, SIGNAL_CODE_RADIO);
            break;
        case MPSL_TIMESLOT_SIGNAL_TIMER0:
            k_poll_signal_raise(&timeslot_sig, SIGNAL_CODE_TIMER0);
            break;
        default:
            k_poll_signal_raise(&timeslot_sig, SIGNAL_CODE_UNEXPECTED);
            break;
        };
        mpsl_callback_signal = INVALID_MPSL_SIGNAL;
    } else {
        /* This is a radio notification. */
#if TS_GPIO_DEBUG
        nrf_gpio_pin_set(RADIO_NOTIFICATION_PIN);
        nrf_gpio_pin_set(RADIO_NOTIFICATION_PIN);
        nrf_gpio_pin_set(RADIO_NOTIFICATION_PIN);
        nrf_gpio_pin_set(RADIO_NOTIFICATION_PIN);
        nrf_gpio_pin_set(RADIO_NOTIFICATION_PIN);
        nrf_gpio_pin_set(RADIO_NOTIFICATION_PIN);
        nrf_gpio_pin_clear(RADIO_NOTIFICATION_PIN);
#endif
        k_poll_signal_raise(&timeslot_sig, SIGNAL_CODE_RNH_ACTIVE);
    }
}

int timeslot_stop(void)
{
    if (!session_open || !timeslot_started) {
        return -TIMESLOT_ERROR_NO_TIMESLOT_STARTED;
    }
    timeslot_stopping = true;
    LOG_INF("timeslot_stop()");
    return 0;
}

int timeslot_start(uint32_t len_us)
{
    if (!session_open || timeslot_started || timeslot_stopping) {
        return -TIMESLOT_ERROR_TIMESLOT_ALREADY_STARTED;
    }

    LOG_INF("timeslot_start(len_us: %d)", len_us);
    ts_len_us               = len_us;
    blocked_cancelled_count = 0;
    timeslot_started        = true;

    request_earliest.params.earliest.length_us = len_us;
    return 0;
}

int timeslot_open(struct timeslot_config *p_config, struct timeslot_cb *p_cb)
{
    if (session_open) {
        return -TIMESLOT_ERROR_SESSION_ALREADY_OPENED;
    }

    if (0 == p_config) {
        return -TIMESLOT_ERROR_INVALID_PARAM;
    }

    if ((0 == p_cb) || (0 == p_cb->error) || (0 == p_cb->start) || (0 == p_cb->end)) {
        return -TIMESLOT_ERROR_INVALID_PARAM;
    }
#if !TIMESLOT_CALLS_RADIO_IRQHANDLER
    if (0 == p_cb->radio_irq) {
        return -TIMESLOT_ERROR_INVALID_PARAM;
    }
#endif

    LOG_INF("timeslot_open(...)");
    int err = mpsl_radio_notification_cfg_set(MPSL_RADIO_NOTIFICATION_TYPE_INT_ON_ACTIVE,
                                                MPSL_RADIO_NOTIFICATION_DISTANCE_800US,
                                                TIMESLOT_IRQN);
    if (err) {
        return err;
    }

    IRQ_CONNECT(DT_IRQN(DT_NODELABEL(TIMESLOT_IRQ_NODELABEL)), TIMESLOT_IRQ_PRIO,
                radio_notify_cb, NULL, 0);
    irq_enable(DT_IRQN(DT_NODELABEL(TIMESLOT_IRQ_NODELABEL)));

    p_timeslot_config    = p_config;
    p_timeslot_callbacks = p_cb;

    request_earliest.params.earliest.hfclk      = p_timeslot_config->hfclk;
    request_earliest.params.earliest.timeout_us = p_timeslot_config->timeout_us;

    err = mpsl_timeslot_session_open(mpsl_cb, &mpsl_session_id);
    if (err) {
        return err;
    }

#if TS_GPIO_DEBUG
    nrf_gpio_cfg_output(TIMESLOT_OPEN_PIN);
    nrf_gpio_cfg_output(TIMESLOT_BLOCKED_PIN);
    nrf_gpio_cfg_output(TIMESLOT_CANCELLED_PIN);
    nrf_gpio_cfg_output(RADIO_NOTIFICATION_PIN);
    nrf_gpio_cfg_output(REQUEST_PIN);
    nrf_gpio_pin_clear(TIMESLOT_OPEN_PIN);
    nrf_gpio_pin_clear(TIMESLOT_BLOCKED_PIN);
    nrf_gpio_pin_clear(TIMESLOT_CANCELLED_PIN);
    nrf_gpio_pin_clear(RADIO_NOTIFICATION_PIN);
    nrf_gpio_pin_clear(REQUEST_PIN);
#endif

    session_open = true;
    return 0;
}

static void timeslot_stopped(void) {
#if TS_GPIO_DEBUG
    nrf_gpio_pin_write(TIMESLOT_OPEN_PIN, 0);
#endif
    timeslot_stopping = false;
    timeslot_started  = false;
    p_timeslot_callbacks->stopped();
}

static void timeslot_thread_fn(void)
{
    int err;

    while (true) {
        k_poll(events, 1, K_FOREVER);

        switch (events[0].signal->result) {
        case SIGNAL_CODE_START:
            p_timeslot_callbacks->start();
            blocked_cancelled_count = 0;
            break;

        case SIGNAL_CODE_TIMER0:
            p_timeslot_callbacks->end();
            break;

#if !TIMESLOT_CALLS_RADIO_IRQHANDLER
        case SIGNAL_CODE_RADIO:
            p_timeslot_callbacks->radio_irq();
            break;
#endif

        case SIGNAL_CODE_BLOCKED_CANCELLED:
            timeslot_requested = false;
#if TS_GPIO_DEBUG
            nrf_gpio_pin_write(TIMESLOT_BLOCKED_PIN,   0);
            nrf_gpio_pin_write(TIMESLOT_CANCELLED_PIN, 0);
#endif
            blocked_cancelled_count++;
            if (blocked_cancelled_count > p_timeslot_config->skipped_tolerance) {
                blocked_cancelled_count = 0;
                p_timeslot_callbacks->error(-TIMESLOT_ERROR_REQUESTS_FAILED);
                break;
            }
            if (timeslot_stopping) {
                timeslot_stopped();
                break;
            }
            p_timeslot_callbacks->skipped(blocked_cancelled_count);
            break;

        case SIGNAL_CODE_IDLE:
            timeslot_requested = false;
            if (timeslot_stopping) {
                timeslot_stopped();
            }
            break;

        case SIGNAL_CODE_OVERSTAYED:
            /* This is the most probable of the what-could-go-wrong scenarios. */
            p_timeslot_callbacks->error(-TIMESLOT_ERROR_OVERSTAYED);
            break;

        case SIGNAL_CODE_UNEXPECTED:
            /* Something like MPSL_TIMESLOT_SIGNAL_INVALID_RETURN happened. */
            p_timeslot_callbacks->error(-TIMESLOT_ERROR_INTERNAL);
            break;

        case SIGNAL_CODE_RNH_ACTIVE:
            if (timeslot_requested) {
                break;
            }
#if TS_GPIO_DEBUG
            nrf_gpio_pin_write(REQUEST_PIN, 1);
#endif
            k_sleep(K_USEC(CONFIG_SDC_MAX_CONN_EVENT_LEN_DEFAULT -
                               TS_REQUEST_DELAY_US + TS_RNH_DISTANCE_US));
#if TS_GPIO_DEBUG
            nrf_gpio_pin_write(REQUEST_PIN, 0);
#endif
            timeslot_requested = true;
            err = mpsl_timeslot_request(mpsl_session_id, &request_earliest);
            if (err) {
                p_timeslot_callbacks->error(err);
            }
            break;

        default:
            p_timeslot_callbacks->error(-TIMESLOT_ERROR_INTERNAL);
            break;
        }

        events[0].signal->signaled = 0;
        events[0].state            = K_POLL_STATE_NOT_READY;
    }
}

K_THREAD_DEFINE(timeslot_thread, TIMESLOT_THREAD_STACK_SIZE,
                    timeslot_thread_fn, NULL, NULL, NULL,
                    K_PRIO_COOP(TIMESLOT_THREAD_PRIORITY), 0, 0);
```
